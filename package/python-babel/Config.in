## package/python-babel/Config.in
```kconfig
config BR2_PACKAGE_PYTHON_BABEL
	bool "python-babel"
	depends on BR2_PACKAGE_PYTHON || BR2_PACKAGE_PYTHON3
	help
	  Babel is an integrated collection of utilities that assist in
	  internationalizing and localizing Python applications, with an
	  emphasis on web-based applications

	  http://babel.pocoo.org/docs/
```

## package/python-bjoern/Config.in
```kconfig
config BR2_PACKAGE_PYTHON_BJOERN
	bool "python-bjoern"
	depends on BR2_PACKAGE_PYTHON || BR2_PACKAGE_PYTHON3
	select BR2_PACKAGE_LIBEV
	help
	  A screamingly fast, ultra-lightweight WSGI server for CPython,
	  written in C using Marc Lehmann's high performance libev event
	  loop and Ryan Dahl's http-parser.

	  https://github.com/jonashaag/bjoern
```

## package/python-bottle-utils/Config.in
```kconfig
config BR2_PACKAGE_PYTHON_BOTTLE_UTILS
	bool "python-bottle-utils"
	select BR2_PACKAGE_PYTHON_BOTTLE
	select BR2_PACKAGE_PYTHON_DATEUTIL

	help
	  Bottle Utils is a collection of loosely related packages for
	  developing web applications using Bottle web framework.

	  http://outernet-project.github.io/bottle-utils/
```

## package/python-dateutil/Config.in
```kconfig
config BR2_PACKAGE_PYTHON_DATEUTIL
	bool "python-dateutil"
	depends on BR2_PACKAGE_PYTHON
	help
	  The dateutil module provides powerful extensions to the datetime
	  module available in the Python standard library.

	  https://dateutil.readthedocs.org/
```

## package/python-fsal/Config.in
```kconfig
config BR2_PACKAGE_PYTHON_FSAL
	bool "python-fsal"
    select BR2_PACKAGE_PYTHON_GEVENT
    select BR2_PACKAGE_PYTHON-DATEUTIL
    select BR2_PACKAGE_PYTHON_SCANDIR
    select BR2_PACKAGE_PYTHON_SIX
    select BR2_PACKAGE_PYTHON_WHEEL
    select BR2_PACKAGE_PYTHON_XMLTODICT

	help
        File System Abstraction Layer is a system which provides a few high 
        level operations on files & folders. The intended utility is for 
        Librarian & other apps to use this to perform File Manager like 
        operations.

        The heavyweight filesystem operations are performed by the daemon via 
        XML based IPC calls.

	  https://github.com/Outernet-Project/fsal/
```

## package/python-librarian-auth/Config.in
```kconfig
config BR2_PACKAGE_PYTHON_LIBRARIAN_AUTH
	bool "python-librarian-auth"
	select BR2_PACKAGE_PYTHON_LIBRARIAN_CORE
    select BR2_PYTHON-PBKDF2
    select BR2_PYTHON-LIBRARIAN_SETUP
    select BR2_PYTHON-LIBRARIAN_MENU

	help
      Module of content library manager for Outernet Receiver

	  https://github.com/Outernet-Project/librarian/
```

## package/python-librarian-captive/Config.in
```kconfig
config BR2_PACKAGE_PYTHON_LIBRARIAN_CAPTIVE
	bool "python-librarian-captive"
	select BR2_PACKAGE_PYTHON_LIBRARIAN_CORE

	help
      Module of content library manager for Outernet Receiver

	  https://github.com/Outernet-Project/librarian-captive/
```

## package/python-librarian-content/Config.in
```kconfig
config BR2_PACKAGE_PYTHON_LIBRARIAN_CONTENT
	bool "python-librarian-content"
	select BR2_PACKAGE_PYTHON_LIBRARIAN_CORE
    select BR2_PACKAGE_PYTHON_SCANDIR
    select BR2_PACKAGE_PYTHON_OUTERNET_METADATA
    select BR2_PACKAGE_PYTHON_FSAL

	help
      Module of content library manager for Outernet Receiver

	  https://github.com/Outernet-Project/librarian/
```

## package/python-librarian-core/Config.in
```kconfig
config BR2_PACKAGE_PYTHON_LIBRARIAN_CORE
	bool "python-librarian-core"
	select BR2_PACKAGE_PYTHON_LIBRARIAN
    select BR2_PACKAGE_PYTHON_CSSMIN
    select BR2_PACKAGE_PYTHON_PYTZ
    select BR2_PACKAGE_PYTHON_SQLIZE
    select BR2_PACKAGE_PYTHON_WEBASSETS

	help
      Module of content library manager for Outernet Receiver

	  https://github.com/Outernet-Project/librarian/
```

## package/python-librarian-dashboard/Config.in
```kconfig
config BR2_PACKAGE_PYTHON_LIBRARIAN_DASHBOARD
	bool "python-librarian-dashboard"
	select BR2_PACKAGE_PYTHON_LIBRARIAN_CORE
	select BR2_PACKAGE_PYTHON_LIBRARIAN_MENU
	select BR2_PACKAGE_PYTHON_LIBRARIAN_AUTH

	help
      Module of content library manager for Outernet Receiver

	  https://github.com/Outernet-Project/librarian/
```

## package/python-librarian-diskspace/Config.in
```kconfig
config BR2_PACKAGE_PYTHON_LIBRARIAN_DISKSPACE
	bool "python-librarian-diskspace"
	select BR2_PACKAGE_PYTHON_LIBRARIAN_CORE
    select BR2_PACKAGE_PYTHON_LIBRARIAN_DASHBOARD
    select BR2_PACKAGE_PYTHON_LIBRARIAN_CONTENT

	help
      Module of content library manager for Outernet Receiver

	  https://github.com/Outernet-Project/librarian/
```

## package/python-librarian-filemanager/Config.in
```kconfig
config BR2_PACKAGE_PYTHON_LIBRARIAN_FILEMANAGER
	bool "python-librarian-filemanager"
	select BR2_PACKAGE_PYTHON_LIBRARIAN_CORE
	select BR2_PACKAGE_PYTHON_LIBRARIAN_CONTENT
	select BR2_PACKAGE_PYTHON_FSAL
	select BR2_PACKAGE_PYTHON_SCANDIR

	help
      Module of content library manager for Outernet Receiver

	  https://github.com/Outernet-Project/librarian/
```

## package/python-librarian-library/Config.in
```kconfig
config BR2_PACKAGE_PYTHON_LIBRARIAN_LIBRARY
	bool "python-librarian-library"
	select BR2_PACKAGE_PYTHON_LIBRARIAN_CORE
    select BR2_PACKAGE_PYTHON_PYTZ
    select BR2_PACKAGE_PYTHON_SCANDIR
    select BR2_PACKAGE_PYTHON_BOTTLE_FDSEND
    select BR2_PACKAGE_PYTHON_OUTERNET_METADATA
    select BR2_PACKAGE_PYTHON_LIBRARIAN_CORE
    select BR2_PACKAGE_PYTHON_LIBRARIAN_MENU
    select BR2_PACKAGE_PYTHON_LIBRARIAN_AUTH
    select BR2_PACKAGE_PYTHON_LIBRARIAN_SETUP
    select BR2_PACKAGE_PYTHON_LIBRARIAN_CONTENT

	help
      Module of content library manager for Outernet Receiver

	  https://github.com/Outernet-Project/librarian/
```

## package/python-librarian-lock/Config.in
```kconfig
config BR2_PACKAGE_PYTHON_LIBRARIAN_LOCK
	bool "python-librarian-lock"
	select BR2_PACKAGE_PYTHON_LIBRARIAN_CORE

	help
      Module of content library manager for Outernet Receiver

	  https://github.com/Outernet-Project/librarian/
```

## package/python-librarian-logs/Config.in
```kconfig
config BR2_PACKAGE_PYTHON_LIBRARIAN_LOGS
	bool "python-librarian-logs"
	select BR2_PACKAGE_PYTHON_LIBRARIAN_CORE
	select BR2_PACKAGE_PYTHON_LIBRARIAN_DASHBOARD

	help
      Module of content library manager for Outernet Receiver

	  https://github.com/Outernet-Project/librarian/
```

## package/python-librarian-menu/Config.in
```kconfig
config BR2_PACKAGE_PYTHON_LIBRARIAN_MENU
	bool "python-librarian-menu"
	select BR2_PACKAGE_PYTHON_LIBRARIAN_CORE

	help
      Module of content library manager for Outernet Receiver

	  https://github.com/Outernet-Project/librarian/
```

## package/python-librarian-netinterfaces/Config.in
```kconfig
config BR2_PACKAGE_PYTHON_LIBRARIAN_NETINTERFACES
	bool "python-librarian-netinterfaces"
	select BR2_PACKAGE_PYTHON_LIBRARIAN_CORE
	select BR2_PACKAGE_PYTHON_LIBRARIAN_DASHBOARD

	help
      Module of content library manager for Outernet Receiver

	  https://github.com/Outernet-Project/librarian/
```

## package/python-librarian-notifications/Config.in
```kconfig
config BR2_PACKAGE_PYTHON_LIBRARIAN_NOTIFICATIONS
	bool "python-librarian-notifications"
	select BR2_PACKAGE_PYTHON_LIBRARIAN_CORE

	help
      Module of content library manager for Outernet Receiver

	  https://github.com/Outernet-Project/librarian/
```

## package/python-librarian-ondd/Config.in
```kconfig
config BR2_PACKAGE_PYTHON_LIBRARIAN_ONDD
	bool "python-librarian-ondd"
	select BR2_PACKAGE_PYTHON_LIBRARIAN_CORE
	select BR2_PACKAGE_PYTHON_LIBRARIAN_SETUP
	select BR2_PACKAGE_PYTHON_LIBRARIAN_DASHBOARD

	help
      Module of content library manager for Outernet Receiver

	  https://github.com/Outernet-Project/librarian/
```

## package/python-librarian-twitter/Config.in
```kconfig
config BR2_PACKAGE_PYTHON_LIBRARIAN_TWITTER
	bool "python-librarian-twitter"
	select BR2_PACKAGE_PYTHON_LIBRARIAN_CORE

	help
      Module of content library manager for Outernet Receiver

	  https://github.com/Outernet-Project/librarian/
```

## package/python-librarian-ui/Config.in
```kconfig
config BR2_PACKAGE_PYTHON_LIBRARIAN_UI
	bool "python-librarian-ui"

	help
      User Interface module of content library manager for Outernet Receiver

	  https://github.com/Outernet-Project/librarian-ui/
```

## package/python-mako/Config.in
```kconfig
config BR2_PACKAGE_PYTHON_MAKO
	bool "python-mako"
	depends on BR2_PACKAGE_PYTHON || BR2_PACKAGE_PYTHON3
	help
	  Mako is a template library written in Python. It provides a
	  familiar, non-XML syntax which compiles into Python modules
	  for maximum performance.

	  http://www.makotemplates.org/
```

## package/python-six/Config.in
```kconfig
config BR2_PACKAGE_PYTHON_SIX
	bool "python-six"
	depends on BR2_PACKAGE_PYTHON || BR2_PACKAGE_PYTHON3
	help
	  Six provides simple utilities for wrapping over differences between
	  Python 2 and Python 3. It is intended to support codebases that work
	  on both Python 2 and 3 without modification

	  http://pypi.python.org/pypi/six/
```

## package/python-wheel/Config.in
```kconfig
config BR2_PACKAGE_PYTHON_WHEEL
	bool "python-wheel"

	help
        A built-package format for Python.

        http://pypi.python.org/pypi/wheel
```

## package/python-xmltodict/Config.in
```kconfig
config BR2_PACKAGE_PYTHON_XMLTODICT
	bool "python-xmltodict"

	help
        A built-package format for Python.

        http://pypi.python.org/pypi/wheel
```
